/* boot.ld - 引导加载程序的链接器脚本 */

OUTPUT_FORMAT("binary") /* 输出格式为原始二进制文件，不带任何头部信息 */
ENTRY(_start)           /* 指定入口点为_start符号 */

SECTIONS
{
    . = 0x7c00;         /* 将代码段的起始地址设置为0x7c00，这是BIOS加载引导扇区的位置 */
    .text :             /* 定义一个名为.text的代码段 */
    {
        code = .;       /* 定义一个符号code，其值为当前地址 */
        *(.text)        /* 包含所有输入文件的.text段（即汇编代码） */
        . = ALIGN(4);   /* 对齐到4字节边界（通常不必要，但好习惯） */
    }

    .data :             /* 定义一个名为.data的数据段 */
    {
        data = .;       /* 定义一个符号data，其值为当前地址 */
        *(.data)        /* 包含所有输入文件的.data段 */
        *(.rodata)      /* 包含所有输入文件的.rodata段（只读数据，如字符串） */
        . = ALIGN(4);
    }

    .bss :              /* 定义一个名为.bss的未初始化数据段 */
    {
        bss = .;
        *(.bss)
        . = ALIGN(4);
    }

    /* 填充引导扇区到512字节并添加魔术数字 */
    .sig :
    {
        . = 0x7c00 + 510; /* 将当前位置移动到引导扇区末尾前两个字节 */
        BYTE(0x55)        /* 写入第一个字节 0x55 */
        BYTE(0xAA)        /* 写入第二个字节 0xAA */
    }

    /DISCARD/ :         /* 丢弃不需要的段，例如.note, .comment等 */
    {
        *(.note*)
        *(.comment*)
        *(.eh_frame*)
    }
}
